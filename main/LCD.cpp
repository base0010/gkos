
#include"LCD.h"

//TTGO pins
U8G2_SSD1306_128X64_NONAME_F_SW_I2C u8g2(U8G2_R0, 15, 4, 16);
//U8G2_SSD1306_128X64_NONAME_F_SW_I2C u8g2(U8G2_R0, 22, 21, 0);

using namespace std;


QRCode qrcode;

uint8_t qrVersion = 10;
uint8_t qrcodeData[407];



std::string qrCodeString = "abc";

//Capital S String seems wrong move default Feeling lcd.h?
void LCD::Print(String msg, Feeling f)
{
    u8g2.clear();

    u8g2.firstPage();
    do
    {
        u8g2.setFont(u8g2_font_helvB10_tr);
//    	u8g2.setFont(u8x8_font_victoriamedium8_r);

//    	u8g2.printf(msg.c_str());
        u8g2.drawStr(0, 13, msg.c_str());

        if(msg.length() > 15){
            u8g2.drawStr(0,27, msg.substring(16).c_str());
        }
        u8g2.setFont(u8g2_font_emoticons21_tr);
        u8g2.drawGlyph(40, 50, f);
    } while (u8g2.nextPage());
}
#define gkLogo_width 128
#define gkLogo_height 64
static unsigned char gkLogo_bits[] = {
    0xff, 0xff, 0xff, 0xff, 0xff, 0xff, 0xff, 0xff, 0xff, 0xff, 0xff, 0xff,
    0xff, 0xff, 0xff, 0xff, 0xff, 0xff, 0xff, 0xff, 0xff, 0xff, 0xff, 0xff,
    0xff, 0xff, 0xff, 0xff, 0xff, 0xff, 0xff, 0xff, 0xff, 0xff, 0xff, 0xff,
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    0xff, 0xff, 0xff, 0xff};


    void LCD::PrintLogo(){
        u8g2.begin();
        u8g2.firstPage();
        do{

        // u8g2.clear();
        u8g2.drawXBM(0, 0, gkLogo_width, gkLogo_height, gkLogo_bits);

        } while (u8g2.nextPage());
        delay(1000);
    }

    void LCD::displayQR(uint8_t x_offset, uint8_t y_offset)
    {
        u8g2.begin();
        u8g2.firstPage();
        do
        {
            qrcode_initText(&qrcode, qrcodeData, qrVersion, 0, qrCodeString.c_str());
            u8g2.drawFrame(0 + x_offset, 0 + y_offset, qrcode.size + 4, qrcode.size + 4);
            u8g2.drawFrame(1 + x_offset, 1 + y_offset, qrcode.size + 2, qrcode.size + 2);
            x_offset += 2;
            y_offset += 2;

            for (uint16_t y = 0; y < qrcode.size; y += 1)
            {
                // Each horizontal module
                for (uint16_t x = 0; x < qrcode.size; x += 1)
                {
                    if (qrcode_getModule(&qrcode, x, y))
                    {
                        // Serial.print("\u2588\u2588");
                    }
                    else
                    {
                        u8g2.drawBox(x + x_offset, y + y_offset, 1, 1);
                        // Serial.print("  ");
                    }
                }
                // Serial.print("\n");
            }
            // int w;
            // u8g2.setDrawColor(1);
            // u8g2.setFont(u8g2_font_5x7_tr);
            // w = u8g2.getUTF8Width(qrCodeString.c_str());

            // for (uint8_t y = 0; y < qrcode.size; y++)
            // {
            //     Serial.println((String) "QR Code is: \n" + qrcode.size + "\nLong");
            //     for (uint8_t x = 0; x < qrcode.size; x++)
            //     {
            //         if (qrcode_getModule(&qrcode, x, y))
            //         {
            //         u8g2.drawBox(2 * x , 2 * y + 6, 2, 2);
            //         }
            //     }
            // }
            // ;
           // u8g2.drawUTF8(127 - w, 63, qrCodeString.c_str());

        } while (u8g2.nextPage());
    }

    void SerialPrintQR(uint8_t x_offset, uint8_t y_offset)
    {
        u8g2.begin();
        u8g2.firstPage();
        do
        {
            qrcode_initText(&qrcode, qrcodeData, qrVersion, 0, qrCodeString.c_str());

            for (uint8_t y = 0; y < qrcode.size; y++)
            {

                // Left quiet zone
                Serial.print("        ");

                // Each horizontal module
                for (uint8_t x = 0; x < qrcode.size; x++)
                {

                    // Print each module (UTF-8 \u2588 is a solid block)
                    Serial.print(qrcode_getModule(&qrcode, x, y) ? "\u2588\u2588" : "  ");
                }

                Serial.print("\n");
            }

            // Bottom quiet zone
            Serial.print("\n\n\n\n");

        } while (u8g2.nextPage());
    }

    void LCD::RecievedPayment(std::string consumerAddress, uint64_t value, bool isETH)
    {
        std::string currency = "DAI";
        if (isETH)
        {
            currency = "ETH";
        }

        std::ostringstream oss;
        oss << "Recieved " << value << currency << "From " << consumerAddress;

        std::string msg = oss.str();

        this->Print(msg.c_str());
    }

    void LCD::CounterSigning()
    {
        //make more dynamic
        LCD::Print("Countersigning Hub Payment");
    }

    void LCD::DeliveringProduct()
    {
        this->Print("Delivering X");
    }

    void LCD::ReadingStates(int numStates){
        std::ostringstream oss;
        oss << "Read " << numStates << "From Flash Storage";
        this->Print(oss.str().c_str());
    }

    void LCD::VerifiedStates(int numStates)
    {
        std::ostringstream oss;
        oss << "Verified " << numStates << "From Flash Storage";
        this->Print(oss.str().c_str());
    }
